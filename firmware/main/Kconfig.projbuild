## firmware/main/Kconfig.projbuild
```kconfig
menu "Voice Assistant Config"

config VA_WIFI_SSID
    string "WiFi SSID"
    default "myssid"
    help
        WiFi network name.

config VA_WIFI_PASSWORD
    string "WiFi Password"
    default "mypassword"
    help
        WiFi password.

config VA_SERVER_URI
    string "Companion server WebSocket URI"
    default "ws://192.168.1.100:8765"
    help
        WebSocket URI of the local companion server.

endmenu
```

## firmware/sdkconfig.defaults
```kconfig
CONFIG_ESP32S3_DEFAULT_CPU_FREQ_240=y
CONFIG_SPIRAM=y
CONFIG_SPIRAM_MODE_OCT=y
CONFIG_SPIRAM_SPEED_80M=y
CONFIG_MBEDTLS_DYNAMIC_BUFFER=y
CONFIG_MBEDTLS_DYNAMIC_FREE_PEER_CERT=y
CONFIG_MBEDTLS_DYNAMIC_FREE_CONFIG_DATA=y
# TODO: REMOVE BEFORE PRODUCTION - disables TLS certificate verification
CONFIG_ESP_TLS_SKIP_SERVER_CERT_VERIFY=y
CONFIG_WEBSOCKET_URI_FROM_STDIN=n
CONFIG_FREERTOS_ENABLE_BACKWARD_COMPATIBILITY=y
CONFIG_PARTITION_TABLE_CUSTOM=y
CONFIG_PARTITION_TABLE_CUSTOM_FILENAME="partitions.csv"
CONFIG_SR_WN_WN9_HIESP=y
```
